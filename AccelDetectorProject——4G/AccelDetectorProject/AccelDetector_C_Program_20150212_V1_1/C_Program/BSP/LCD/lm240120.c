
#include "lm240120.h"
#include "stm32f10x.h"
#include "delay.h"

/*----------ASCII 字符库----------------------------------*/
//说明：该字库为5*7点阵字符字模库，但字库格式为8*8点阵字模数据，第8行为行间距
//第6-8列为字间距。可以使用6*8点阵、7*点阵、8*8点阵形式的字符显示
u8 const ASCIITAB8_8[]={
0x00,0x00,0x00,0x00,0x00,0x00,0x00,0x00,/*" ",0*/

0x00,0x00,0x00,0x5E,0x40,0x00,0x00,0x00,/*"!",1*/
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0x00,0x02,0x01,0x01,0x01,0x02,0x02,0x02,/*"~",94*/


	};
/*-----------------------------------------------------------------
 (0) !(1) "(2) #(3) $(4) %(5) &(6) '(7) ((8) )(9) *(10) +(11) ,(12) -(13) .(14) /(15)
 0(16) 1(17) 2(18) 3(19) 4(20) 5(21) 6(22) 7(23) 8(24) 9(25) :(26) ;(27) <(28) =(29) >(30) ?(31)
 @(32) A(33) B(34) C(35) D(36) E(37) F(38) G(39) H(40) I(41) J(42) K(43) L(44) M(45) N(46) O(47)
 P(48) Q(49) R(50) S(51) T(52) U(53) V(54) W(55) X(56) Y(57) Z(58) [(59) \(60) ](61) ^(62) _(63)
 ,(64) a(65) b(66) c(67) d(68) e(69) f(70) g(71) h(72) i(73) j(74) k(75) l(76) m(77) n(78) o(79)
 p(80) q(81) r(82) s(83) t(84) u(85) v(86) w(87) x(88) y(89) z(90) {(91) |(92) }(93) ~(94)

-----------------------------------------------------------------*/
//隶书
u8 const ASCIITAB8_16[] = {

0x00,0x00,0x00,0x00,0x00,0x00,0x00,0x00,0x00,0x00,0x00,0x00,0x00,0x00,0x00,0x00,/*" ",0*/

0x00,0x00,0x00,0xF8,0x00,0x00,0x00,0x00,0x00,0x00,0x00,0x33,0x30,0x00,0x00,0x00,/*"!",1*/
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0x00,0x06,0x01,0x01,0x02,0x02,0x04,0x04,0x00,0x00,0x00,0x00,0x00,0x00,0x00,0x00/*"~",94*/

};

u8 const IndicatorTab[] = {
0xC0,0xC0,0xC0,0xF8,0xF0,0xE0,0xC0,0x80,0x01,0x01,0x01,0x0F,0x07,0x03,0x01,0x00/*"-->",0*/
};
/*---------------------------------------------------------------------------
**	Function	: 
**	Parameters	:
**	Retval		:
**	Description	: 
---------------------------------------------------------------------------*/
void LM_GPIO_Config(void)
{
	GPIO_InitTypeDef GPIO_InitStructure;

	RCC_APB2PeriphClockCmd(	LM_BL_GPIO_RCC_Periph|LM_CS_GPIO_RCC_Periph|
							LM_RST_GPIO_RCC_Periph|LM_DC_GPIO_RCC_Periph|
							LM_WR_GPIO_RCC_Periph|LM_DATA_BUS_RCC_Periph,ENABLE);
	
	GPIO_InitStructure.GPIO_Pin =  LM_BL_GPIO_Pin;
	GPIO_InitStructure.GPIO_Speed = GPIO_Speed_50MHz;
	GPIO_InitStructure.GPIO_Mode = GPIO_Mode_Out_PP;
	GPIO_Init(LM_BL_GPIO_Port, &GPIO_InitStructure);
	
	GPIO_InitStructure.GPIO_Pin =  LM_CS_GPIO_Pin;
	GPIO_InitStructure.GPIO_Speed = GPIO_Speed_50MHz;
	GPIO_InitStructure.GPIO_Mode = GPIO_Mode_Out_PP;
	GPIO_Init(LM_CS_GPIO_Port, &GPIO_InitStructure);
	
	GPIO_InitStructure.GPIO_Pin =  LM_RST_GPIO_Pin;
	GPIO_InitStructure.GPIO_Speed = GPIO_Speed_50MHz;
	GPIO_InitStructure.GPIO_Mode = GPIO_Mode_Out_PP;
	GPIO_Init(LM_RST_GPIO_Port, &GPIO_InitStructure);
	
	GPIO_InitStructure.GPIO_Pin =  LM_DC_GPIO_Pin;
	GPIO_InitStructure.GPIO_Speed = GPIO_Speed_50MHz;
	GPIO_InitStructure.GPIO_Mode = GPIO_Mode_Out_PP;
	GPIO_Init(LM_DC_GPIO_Port, &GPIO_InitStructure);
	
	GPIO_InitStructure.GPIO_Pin =  LM_WR_GPIO_Pin;
	GPIO_InitStructure.GPIO_Speed = GPIO_Speed_50MHz;
	GPIO_InitStructure.GPIO_Mode = GPIO_Mode_Out_PP;
	GPIO_Init(LM_WR_GPIO_Port, &GPIO_InitStructure);
	
	GPIO_InitStructure.GPIO_Pin =  GPIO_Pin_All;
	GPIO_InitStructure.GPIO_Speed = GPIO_Speed_50MHz;
	GPIO_InitStructure.GPIO_Mode = GPIO_Mode_Out_PP;
	GPIO_Init(LM_DATA_BUS_Port, &GPIO_InitStructure);
	
}

/*---------------------------------------------------------------------------
**	Function	: 
**	Parameters	:
**	Retval		:
**	Description	: 使用PE的高8位作为数据总线
---------------------------------------------------------------------------*/
void LM_SdCmd(u8 Command)   //send command
{
	GPIO_WriteBit(LM_DC_GPIO_Port, LM_DC_GPIO_Pin, Bit_RESET);	
	GPIO_Write(LM_DATA_BUS_Port, (u16)Command << 8);	//low 8 bits of bus por is not used 
	GPIO_WriteBit(LM_CS_GPIO_Port, LM_CS_GPIO_Pin, Bit_SET);
	GPIO_WriteBit(LM_WR_GPIO_Port, LM_WR_GPIO_Pin, Bit_RESET);	
	GPIO_WriteBit(LM_WR_GPIO_Port, LM_WR_GPIO_Pin, Bit_SET);
	GPIO_WriteBit(LM_CS_GPIO_Port, LM_CS_GPIO_Pin, Bit_RESET);	
}
/*---------------------------------------------------------------------------
**	Function	: 
**	Parameters	:
**	Retval		:
**	Description	: 
---------------------------------------------------------------------------*/
void LM_SdData(u8 DData)   //send data
{
	GPIO_WriteBit(LM_DC_GPIO_Port, LM_DC_GPIO_Pin, Bit_SET);
	GPIO_Write(LM_DATA_BUS_Port, (u16)DData << 8);			//low 8 bits of bus por is not used 
	GPIO_WriteBit(LM_CS_GPIO_Port, LM_CS_GPIO_Pin, Bit_SET);
	GPIO_WriteBit(LM_WR_GPIO_Port, LM_WR_GPIO_Pin, Bit_RESET);	
	GPIO_WriteBit(LM_WR_GPIO_Port, LM_WR_GPIO_Pin, Bit_SET);
	GPIO_WriteBit(LM_CS_GPIO_Port, LM_CS_GPIO_Pin, Bit_RESET);	
}
/*---------------------------------------------------------------------------
**	Function	: 
**	Parameters	:
**	Retval		:
**	Description	: 
---------------------------------------------------------------------------*/
void LM_Init(void)
{
	GPIO_WriteBit(LM_RST_GPIO_Port, LM_RST_GPIO_Pin, Bit_SET);
	delay_ms(100);
	GPIO_WriteBit(LM_RST_GPIO_Port, LM_RST_GPIO_Pin, Bit_RESET);
	delay_ms(1);
	GPIO_WriteBit(LM_RST_GPIO_Port, LM_RST_GPIO_Pin, Bit_SET);
	delay_ms(50);
	
	LM_SdCmd(0x26);            	// 设置占空比1/128，温度系数设置0.1%/C
    LM_SdCmd(0x40);            	// 设置显示起始行 = 0
    LM_SdCmd(0x89);            	// 设置页/列地址自动加1
    LM_SdCmd(0xAF);            	// 开显示
    LM_SdCmd(0x90);            	// 固定区域行数 = 0
	LM_SdCmd(0xC4);            	// 设置水平映像为逆序，垂直映像为正序，数据排序D0-D7
    LM_SdCmd(0xEA);           	// 设置占空比1/12
    LM_SdCmd(0x2D);            	// 设置内部LCD电源
   	LM_SdCmd(0x81);            	// 设置对比度
	LM_SdCmd(0x20);   			// 对比度初始值
}
/*---------------------------------------------------------------------------
**	Function	: 
**	Parameters	:
**	Retval		:
**	Description	: 
---------------------------------------------------------------------------*/
void LM_BL_Cmd(FunctionalState NewState)
{
	if(NewState != DISABLE)
		GPIO_WriteBit(LM_BL_GPIO_Port, LM_BL_GPIO_Pin, Bit_SET);
	else
		GPIO_WriteBit(LM_BL_GPIO_Port, LM_BL_GPIO_Pin, Bit_RESET);
				
}
/*---------------------------------------------------------------------------
**	Function	: 
**	Parameters	:
**	Retval		:
**	Description	: 
---------------------------------------------------------------------------*/
void LM_Clear(void)
{
	uchar i,j;
    LM_SdCmd(0xb0);             // set page addr
    LM_SdCmd(0x00);             // page addr high 4bits
    LM_SdCmd(0x10);             // page addr low 4bits

    for (i=0;i<16;i++)        // write page for 16 times
    {
		for(j=0;j<240;j++)       // 240 units
		{
			LM_SdData(0);            // set value to 0
		}
    }
}
/*---------------------------------------------------------------------------
**	Function	: 
**	Parameters	:
**	Retval		:
**	Description	: 
---------------------------------------------------------------------------*/
void LM_DrawPoint(u16 x,u16 y)
{
	u16 k;
//	k=y/8;
	k = y>>3;
	LM_SdCmd(k|0xb0); 
	LM_SdCmd(x&0x0f);  
	LM_SdCmd((x>>4)|0x10); 
	
	LM_SdData(0x01<<(y%8));	
		
}
/*---------------------------------------------------------------------------
**	Function	: 
**	Parameters	:
**	Retval		:
**	Description	: 
---------------------------------------------------------------------------*/
void LM_DispChar(u16 x,u16 y,char Char)
{
	u16 i;
	u16 CharTabLocation;
	
	LM_SdCmd(y|0xb0);               // 设置页地址
	LM_SdCmd(x&0x0f);               // 设置列地址低4位
	LM_SdCmd((x>>4)|0x10);          // 设置列地址高4位
	
	CharTabLocation = (Char - 32)<<4;
	for(i=0;i<8;i++)
		LM_SdData(ASCIITAB8_16[CharTabLocation + i]);  	// 写字模数据
	
	LM_SdCmd((y+1)|0xb0);               // 设置页地址
	LM_SdCmd(x&0x0f);               // 设置列地址低4位
	LM_SdCmd((x>>4)|0x10);          // 设置列地址高4位
	
	for(i=8;i<16;i++)
		LM_SdData(ASCIITAB8_16[CharTabLocation+i]);  	// 写字模数据
	
}
/*---------------------------------------------------------------------------
**	Function	: 
**	Parameters	:
**	Retval		:
**	Description	: 
---------------------------------------------------------------------------*/
void LM_DispChar8_8(u16 x,u16 y,char Char)
{
	u16 i;
	u16 CharTabLocation;
	
	LM_SdCmd(y|0xb0);               // 设置页地址
	LM_SdCmd(x&0x0f);               // 设置列地址低4位
	LM_SdCmd((x>>4)|0x10);          // 设置列地址高4位
	
	CharTabLocation = (Char - 32)<<3;
	for(i=0;i<8;i++)
		LM_SdData(ASCIITAB8_8[CharTabLocation + i]);  	// 写字模数据	
}
///*---------------------------------------------------------------------------
//**	Function	: 
//**	Parameters	:	x水平方向像素列，y垂直方向字符行（8像素/行）
//**	Retval		:
//**	Description	: 
//---------------------------------------------------------------------------*/
void LM_DispStr8_8(uint x,uint y,uchar *pstr)
{
	while(*pstr)
	{
		x += 8;
		LM_DispChar8_8(x,y,*pstr++);
	}	
}
void LM_DispStr(uint x,uint y,uchar *pstr)
{
//  uchar j;
//  uint addr;
//  LM_SdCmd(y|0xb0);               // 设置页地址
//  LM_SdCmd(x&0x0f);               // 设置列地址低4位
//  LM_SdCmd((x>>4)|0x10);          // 设置列地址高4位

//  while(*pstr>0)
//  {
//	addr=*pstr++;                // 取字符代码
//	addr=(addr-0x20)*8;          // 计算字模起始地址
//	for (j=0;j<6;j++)            // 设置循环量，显示6*8点字符
//    {
//		LM_SdData(ASCIITAB[addr+j]);  // 写字模数据
//    }
//  }
	
	while(*pstr)
	{
		x += 8;
		LM_DispChar(x,y,*pstr++);
	}
}
/*---------------------------------------------------------------------------
**	Function	: 
**	Parameters	:
**	Retval		:
**	Description	: 
---------------------------------------------------------------------------*/
void LM_DispIndicator(u16 x,u16 y)
{
	u8 i;
	LM_SdCmd(y|0xb0);               // 设置页地址
	LM_SdCmd(x&0x0f);               // 设置列地址低4位
	LM_SdCmd((x>>4)|0x10);          // 设置列地址高4位
	
	for(i=0;i<8;i++)
		LM_SdData(IndicatorTab[i]);  	// 写字模数据
	
	LM_SdCmd((y+1)|0xb0);               // 设置页地址
	LM_SdCmd(x&0x0f);               // 设置列地址低4位
	LM_SdCmd((x>>4)|0x10);          // 设置列地址高4位
	
	for(i=8;i<16;i++)
		LM_SdData(IndicatorTab[i]);  	// 写字模数据
	
}


void LM_DispCharWithLine(u16 x,u16 y,char Char)
{
	u16 i;
	u16 CharTabLocation;
	
	LM_SdCmd(y|0xb0);               // 设置页地址
	LM_SdCmd(x&0x0f);               // 设置列地址低4位
	LM_SdCmd((x>>4)|0x10);          // 设置列地址高4位
	
	CharTabLocation = (Char - 32)<<4;
	for(i=0;i<8;i++)
		LM_SdData(ASCIITAB8_16[CharTabLocation + i]);  	// 写字模数据
	
	LM_SdCmd((y+1)|0xb0);               // 设置页地址
	LM_SdCmd(x&0x0f);               // 设置列地址低4位
	LM_SdCmd((x>>4)|0x10);          // 设置列地址高4位
	
	for(i=8;i<16;i++)
		LM_SdData(ASCIITAB8_16[CharTabLocation+i] + 0x80);  	// 写字模数据
	
}
/*---------------------------------------------------------------------------
**	Function	: 
**	Parameters	:
**	Retval		:
**	Description	: only used for display battery
---------------------------------------------------------------------------*/
void LM_WriteColumn(u8 x,u8 y,u8 CharCode)
{
	LM_SdCmd(y|0xb0);               // 设置页地址
	LM_SdCmd(x&0x0f);               // 设置列地址低4位
	LM_SdCmd((x>>4)|0x10);          // 设置列地址高4位	
	
	LM_SdData(CharCode);
}




